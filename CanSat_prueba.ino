#include <SPI.h>
#include <Wire.h>
#include <Adafruit_GFX.h>
#include <Adafruit_SSD1306.h>
#include <LoRa.h>
#include <SD.h>
#include <Adafruit_GPS.h>



// Paquete de datos
// Presión (Pa) int
// Temperatura (C) float
// Latitud (º) double
// Longitud (º) double
// Altura GPS float


const int chipSelect = 6;
int voltage = 0;


//GPS
int tiempo = 0;
float latitudgps;
float longitudgps;
float latitudet;
float longitudet;
String cadena;
char lastbyte;
int packetSize;


//Tarjeta SD
File archivo;

//GPS
#define GPSserial Serial2
Adafruit_GPS GPS(&GPSserial);

//Pantalla
#define SCREEN_WIDTH 128 // OLED display width, in pixels
#define SCREEN_HEIGHT 64 // OLED display height, in pixels
#define SCREEN_ADDRESS 0x3C

#define OLED_RESET     4 // Reset pin # (or -1 if sharing Arduino reset pin)
Adafruit_SSD1306 display(SCREEN_WIDTH, SCREEN_HEIGHT, &Wire, OLED_RESET);


//Definimos los logos del Viera y de ArtemiSat

// "VIERA VERSION PRINCIPAL", 128x64px
const unsigned char logoviera [] PROGMEM = {
  0x00, 0x00, 0x00, 0x00, 0x00, 0x00, 0x00, 0x0f, 0xf0, 0x00, 0x00, 0x00, 0x00, 0x00, 0x00, 0x00,
  0x00, 0x00, 0x00, 0x00, 0x00, 0x00, 0x01, 0xe0, 0x07, 0x80, 0x00, 0x00, 0x00, 0x00, 0x00, 0x00,
  0x00, 0x00, 0x00, 0x00, 0x00, 0x00, 0x0e, 0x00, 0x00, 0x30, 0x00, 0x00, 0x00, 0x00, 0x00, 0x00,
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  0x00, 0x00, 0x00, 0x00, 0x00, 0x00, 0x00, 0x7f, 0xfe, 0x00, 0x00, 0x00, 0x00, 0x00, 0x00, 0x00
};

// "ARTEMISAT VERSION PRINCIPAL", 128x64px
const unsigned char logoArtemiSat [] PROGMEM = {
  0x00, 0x00, 0x00, 0x00, 0x00, 0x00, 0x00, 0x00, 0x00, 0x00, 0x00, 0x00, 0x00, 0x00, 0x00, 0x00,
  0x00, 0x00, 0x00, 0x00, 0x00, 0x00, 0x00, 0x01, 0x80, 0x00, 0x00, 0x00, 0x00, 0x00, 0x00, 0x00,
  0x00, 0x00, 0x00, 0x00, 0x00, 0x00, 0x00, 0x01, 0xc0, 0x00, 0x00, 0x00, 0x00, 0x00, 0x00, 0x00,
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  0x00, 0x00, 0x00, 0x00, 0x00, 0x00, 0x00, 0x00, 0x00, 0x00, 0x00, 0x00, 0x00, 0x00, 0x00, 0x00
};


void setup() {

  Serial.begin(9600);
  GPS.begin(9600);

  // Inicializamos LoRa
  if (!LoRa.begin(868E6)) {
    delay(1000);
    Serial.println("Starting LoRa failed!");
    while (1);
  } else {
    delay(1000);
    Serial.println("Starting Lora successfully");
  }


  //Inicializando GPS
  GPS.sendCommand(PMTK_SET_NMEA_OUTPUT_GGAONLY);
  GPS.sendCommand(PGCMD_NOANTENNA);


  //Inicializamos lector de tarjetas SD
  pinMode(chipSelect, OUTPUT);
  digitalWrite(chipSelect, HIGH);
  
  Serial.println("Inicializando lector de tarjeta SD");
  if (!SD.begin(chipSelect)) {
    Serial.println("No se ha encontrado una tarjeta disponible");
    while (1);
  }
  Serial.println("Lector de tarjeta SD inicializado");

  //SD.mkdir("ArtemiSat/artemisat.txt");
  archivo = SD.open("artemisat.txt", FILE_WRITE);
  archivo.println("Cabecera datos");
  archivo.close();
  digitalWrite(chipSelect, LOW);
  
  
  //Inicializamos la oled
  if (!display.begin(SSD1306_SWITCHCAPVCC, SCREEN_ADDRESS)) {
    Serial.println(F("SSD1306 allocation failed"));
    for (;;); // Don't proceed, loop forever
  }

  display.clearDisplay();


  for (int i = 1; i < display.height() / 2; i++) {
    display.drawCircle(display.width() / 2, display.height() / 2, i, WHITE);
    display.display();
    delay(8);
  }

  display.clearDisplay();
  display.drawBitmap(0, 0, logoviera, 128, 64, WHITE);
  display.display();
  delay(2000);

  for (int i = 68; i > display.height() / 2; i--) {
    display.drawCircle(display.width() / 2, display.height() / 2, i, WHITE);
    display.display();
    delay(8);
  }

  display.clearDisplay();
  display.drawBitmap(0, 0, logoArtemiSat, 128, 64, WHITE);
  display.display();
  delay(4000);
}

void loop() {
  packetSize = LoRa.parsePacket();

  if (packetSize) {
    String cadena;
    while (LoRa.available()) {
      lastbyte = LoRa.read();
      cadena += lastbyte;
    }
    Serial.println(cadena);
  }

  if (millis() - tiempo > 1000) {
    tiempo = millis();
    GPS.read();
    if (GPS.newNMEAreceived()) {
      Serial.println(GPS.lastNMEA());
      GPS.parse(GPS.lastNMEA());
    }
    Serial.print("\nHora: ");
    if (GPS.hour < 10) {        //todos es tos if(x<10) son para que quede 02:03:07.001 en vez de 2:3:7.1
      Serial.print('0');
    }
    Serial.print(GPS.hour, DEC);
    Serial.print(':');
    if (GPS.minute < 10) {
      Serial.print('0');
    }
    Serial.print(GPS.minute, DEC);
    Serial.print(':');
    if (GPS.seconds < 10) {
      Serial.print('0');
    }
    Serial.print(GPS.seconds, DEC);
    Serial.print('.');
    if (GPS.milliseconds < 10) {
      Serial.print("00");
    } else if (GPS.milliseconds > 9 && GPS.milliseconds < 100) {
      Serial.print("0");
    }
    Serial.println(GPS.milliseconds);

    Serial.print("Fecha: ");
    Serial.print(GPS.day, DEC);
    Serial.print('/');
    Serial.print(GPS.month, DEC);
    Serial.print("/20");
    Serial.println(GPS.year, DEC);

    Serial.print("Fix: ");
    Serial.print((int)GPS.fix);
    Serial.print(" calidad: ");
    Serial.println((int)GPS.fixquality);

    if (GPS.fix) {
      Serial.print("latitud y longitud: ");
      Serial.print(GPS.latitude, 4);
      Serial.print(GPS.lat);
      Serial.print(", ");
      Serial.print(GPS.longitude, 4);
      Serial.println(GPS.lon);

      Serial.print("Altitud: ");
      Serial.println(GPS.altitude / 100);
      Serial.print(" m");
    }

    Serial.print(cadena);

    String lati = String(cadena.charAt(1)) + String(cadena.charAt(2)) + String(cadena.charAt(3)) + String(cadena.charAt(4)) + String(cadena.charAt(5)) + String(cadena.charAt(6)) + String(cadena.charAt(7)) + String(cadena.charAt(8)) + String(cadena.charAt(9)) + String(cadena.charAt(10)) + String(cadena.charAt(11));
    float latitudgpsnmea = lati.toFloat();
    String longi = String(cadena.charAt(13)) + String(cadena.charAt(14)) + String(cadena.charAt(15)) + String(cadena.charAt(16)) + String(cadena.charAt(17)) + String(cadena.charAt(18)) + String(cadena.charAt(19)) + String(cadena.charAt(20)) + String(cadena.charAt(21)) + String(cadena.charAt(22)) + String(cadena.charAt(23));
    float longitudgpsnmea = longi.toFloat();

    latitudgps = getmetros(latitudgpsnmea);
    longitudgps = getmetros(longitudgpsnmea);

    Serial.print("\nLatitud: ");
    Serial.println(latitudgps, 6);
    Serial.print("Longitud: ");
    Serial.println(longitudgps, 6);
  }
  
  //Escribiendo en la tarjeta SD
  if (archivo) {
    archivo.println((char)LoRa.read());  // escritura de una linea de texto en archivo
    Serial.println("Escribiendo en archivo artemisat.txt..."); // texto en monitor serie
    archivo.close();        // cierre del archivo
    Serial.println("Escritura correcta"); // texto de escritura correcta en monitor serie
  } else {
    Serial.println("Error en apertura de artemisat.txt");  // texto de falla en apertura de archivo
  }
}

if (millis() - tiempo > 1000) {
  tiempo = millis();
  display.clearDisplay();

  update_screen(paquetes, rssi, voltage);
}

//Escribimos en la tarjeta SD
archivo.println((char)LoRa.read());

}

// Actualiza la pantalla OLED para mostrar información
void update_screen(int paquetes, int rssi, float voltage) {

  int packetSize;

  display.clearDisplay();

  display.setTextSize(1);
  display.setTextColor(SSD1306_WHITE);
  display.setCursor(8, 0);

  display.println("Estacion de tierra");
  display.println("");

  display.setCursor(40, 10);
  display.println("ArtemiSat");
  display.println("");

  // Informar de paquetes recibidos
  display.print("Pa. re.: ");
  display.println(paquetes);

  display.print("RSSI: ");
  display.println(rssi);

  display.print("V: ");
  display.print(voltage);
  display.println(" V");

  display.display();

  display.print("lat:");
  display.print(latitudgps);

}

void getmetros(float nmea) {                  //Pasa la latitud del formato NMEA a metros
  String raw = String(nmea, 6); //Lo pasamos a String
  String gradosraw = String(raw.charAt(0)) + String(raw.charAt(1));  //Extraemos los grados del String
  int grados = gradosraw.toInt();
  String minutosraw = String(raw.charAt(2)) + String(raw.charAt(3));  //Extraemos los minutos del String
  int minutos = minutosraw.toInt();
  String mindec = String("0.") + String(raw.charAt(5)) + String(raw.charAt(6)) + String(raw.charAt(7)) + String(raw.charAt(8)) + String(raw.charAt(9)) + String(raw.charAt(10)) + String(raw.charAt(11));
  int segundos = mindec.toFloat() * 60;               //Extraemos los minutos decimales y los pasamos a segundos
  double metros = (grados * 3600 + minutos * 60 + segundos) * 30.5; //Pasamos los datos a metros
  Serial.print(metros, 6);
  return metros;
}
